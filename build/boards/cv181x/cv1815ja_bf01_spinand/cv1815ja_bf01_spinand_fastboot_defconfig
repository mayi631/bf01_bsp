## build/boards/cv181x/cv1815ja_bf01_spinand/cv1815ja_bf01_spinand_fastboot_defconfig
```kconfig
CONFIG_CHIP_cv1815ja=y
CONFIG_BOARD_bf01_spinand=y
CONFIG_DDR_CFG_ddr3_1866_x16=y
CONFIG_ARCH="arm"
CONFIG_CROSS_COMPILE_KERNEL="arm-linux-gnueabihf-"
CONFIG_CC_OPTIMIZE_FOR_SIZE=y
CONFIG_KERNEL_ENTRY_HACK=y
CONFIG_KERNEL_ENTRY_HACK_ADDR="0x80108000"
CONFIG_TOOLCHAIN_GLIBC_ARM=y
CONFIG_FLASH_SIZE_SHRINK=y
CONFIG_NO_FB=y
CONFIG_NO_TP=y
CONFIG_BOOT_TIME_OPTIMIZATION=y
CONFIG_BOOT_IMAGE_SINGLE_DTB=y
CONFIG_STORAGE_TYPE_spinand=y
CONFIG_UBOOT_2021_10=y
CONFIG_UBOOT_SPL_CUSTOM=y
CONFIG_KERNEL_SRC_5.10=y
CONFIG_KERNEL_LZMA=y
CONFIG_SKIP_RAMDISK=y
CONFIG_SENSOR_TUNING_PARAM_cv181x_src_gcore_gc4653=y
# CONFIG_ROOTFS_OVERLAYFS is not set
CONFIG_TARGET_PACKAGE_DROPBEAR=y
CONFIG_TARGET_PACKAGE_MTD-UTILS=y
# CONFIG_TARGET_PACKAGE_RSYSLOG is not set
CONFIG_TARGET_PACKAGE_BUSYBOX_SYSLOGD_SCRIPT=y
CONFIG_TARGET_PACKAGE_GATORD=n
CONFIG_VO=y
# CONFIG_ENABLE_FREERTOS is not set
CONFIG_ENABLE_ALIOS=y
CONFIG_RTOS_INIT_MEDIA=n
CONFIG_CV1815JA_BF01_SPINAND=y
CONFIG_C906L_DMA_ENABLE=n
CONFIG_SUSPEND=n

# fastboot
CONFIG_FASTBOOT=y
CONFIG_FAST_SOLUTION=y
CONFIG_ALIOS_CUSTOMIZATION_PIPELINE="cv1815ja_bf01_spinand"
CONFIG_RTOS_INIT_MEDIA=y

# adbd
CONFIG_TARGET_PACKAGE_ADBD=y

# vuart
CONFIG_VIRTUAL_UART=y

# sensor
CONFIG_SENSOR_GCORE_GC4683=y
```
