/dts-v1/;
#include "cv181x_base_arm.dtsi"
#include "cv181x_asic_bga.dtsi"
#include "cv181x_asic_spinand.dtsi"
#include "cv181x_default_memmap.dtsi"

/ {

};

&wifisd{
	status = "okay";
	max-frequency = <25000000>;
};

&porta {
	wifi-reset-hog {
		gpio-hog;
		gpios = <20 GPIO_ACTIVE_HIGH>;
		output-high;
		line-name = "wifi-reset";
	};
};

&sd {
    no-1-8-v;
};
